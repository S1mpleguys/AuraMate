## components/board/Kconfig
```kconfig
menu "AuraMate Board Config"

config AURAMATE_I2C_PORT
    int "I2C controller index"
    range 0 1
    default 0
    help
        I2C controller index used by Bosch sensor daughter board.

config AURAMATE_I2C_SDA_GPIO
    int "I2C SDA GPIO"
    default -1
    help
        Keep -1 until the board pin map is confirmed.

config AURAMATE_I2C_SCL_GPIO
    int "I2C SCL GPIO"
    default -1
    help
        Keep -1 until the board pin map is confirmed.

config AURAMATE_I2C_FREQ_HZ
    int "I2C bus frequency (Hz)"
    range 100000 1000000
    default 400000
    help
        Default to Fast Mode for the sensor bus.

config AURAMATE_I2S_PORT
    int "I2S controller index"
    range 0 1
    default 0

config AURAMATE_I2S_MCLK_GPIO
    int "I2S MCLK GPIO"
    default -1

config AURAMATE_I2S_BCLK_GPIO
    int "I2S BCLK GPIO"
    default -1

config AURAMATE_I2S_WS_GPIO
    int "I2S WS/LRCK GPIO"
    default -1

config AURAMATE_I2S_DOUT_GPIO
    int "I2S DOUT GPIO"
    default -1

config AURAMATE_I2S_DIN_GPIO
    int "I2S DIN GPIO"
    default -1

config AURAMATE_LCD_HOST_ID
    int "LCD SPI host index"
    range 0 3
    default 1

config AURAMATE_LCD_SCLK_GPIO
    int "LCD SCLK GPIO"
    default -1

config AURAMATE_LCD_MOSI_GPIO
    int "LCD MOSI GPIO"
    default -1

config AURAMATE_LCD_CS_GPIO
    int "LCD CS GPIO"
    default -1

config AURAMATE_LCD_DC_GPIO
    int "LCD DC GPIO"
    default -1

config AURAMATE_LCD_RST_GPIO
    int "LCD RST GPIO"
    default -1

config AURAMATE_LCD_BL_GPIO
    int "LCD backlight GPIO"
    default -1

config AURAMATE_RGB_GPIO
    int "RGB light GPIO"
    default -1
    help
        Data pin for RGB strip or status LED.

endmenu
```

## components/services/Kconfig
```kconfig
menu "AuraMate Feature Flags"

config AURAMATE_FEATURE_ENV
    bool "Enable environment service"
    default y
    help
        Reserve BME690 sampling and environment alert flow.

config AURAMATE_FEATURE_MOTION
    bool "Enable motion service"
    default y
    help
        Reserve motion sampling and scoring flow.

config AURAMATE_FEATURE_AUDIO
    bool "Enable voice service"
    default y
    help
        Reserve I2S capture, playback and wake-word flow.

config AURAMATE_FEATURE_DISPLAY
    bool "Enable display and lighting service"
    default y
    help
        Reserve LCD pages and RGB breathing effect.

config AURAMATE_FEATURE_CLOUD
    bool "Enable cloud connectivity service"
    default y
    help
        Reserve HTTP or MQTT integration for cloud services.

config AURAMATE_FEATURE_BLE_EXT_NODES
    bool "Enable BLE extension motion nodes"
    default y
    depends on AURAMATE_FEATURE_MOTION
    help
        Reserve BLE motion nodes for wrist and ankle sensors.

endmenu
```

## sdkconfig.defaults
```kconfig
CONFIG_IDF_TARGET="esp32c5"
CONFIG_ESPTOOLPY_FLASHSIZE_2MB=y
CONFIG_ESPTOOLPY_FLASHSIZE="2MB"
CONFIG_COMPILER_OPTIMIZATION_SIZE=y
CONFIG_LOG_DEFAULT_LEVEL_INFO=y

CONFIG_PARTITION_TABLE_CUSTOM=y
CONFIG_PARTITION_TABLE_CUSTOM_FILENAME="partitions.csv"
CONFIG_PARTITION_TABLE_FILENAME="partitions.csv"

CONFIG_AURAMATE_FEATURE_ENV=y
CONFIG_AURAMATE_FEATURE_MOTION=y
CONFIG_AURAMATE_FEATURE_AUDIO=y
CONFIG_AURAMATE_FEATURE_DISPLAY=y
CONFIG_AURAMATE_FEATURE_CLOUD=y
CONFIG_AURAMATE_FEATURE_BLE_EXT_NODES=y
```
